// Reflective LCD ST7302 250x122px with Arduino UNO
// displaying Fuel and Coolant Temperature gauges with u8g2 library

// created by upir, 2024
// youtube channel: https://www.youtube.com/upir_upir

// YOUTUBE VIDEO: https://youtu.be/ADmfI2H1qME
// Source Files: https://github.com/upiir/arduino_reflective_lcd_display

// Links from the video:
// Do you like this video? You can buy me a coffee ☕: https://www.buymeacoffee.com/upir
// ST7302 250x122px Reflective LCD Display: https://s.click.aliexpress.com/e/_oosCPEF
// U8g2 gallery: https://github.com/olikraus/u8g2/wiki/gallery#18-sep-2024-st7302-122x250-lcd
// Breadboard wires: https://s.click.aliexpress.com/e/_Dkbngin
// Arduino UNO: https://s.click.aliexpress.com/e/_AXDw1h
// Arduino breadboard prototyping shield: https://s.click.aliexpress.com/e/_ApbCwx
// Image2cpp (convert array to image): https://javl.github.io/image2cpp/
// Photopea (online graphics editor like Photoshop): https://www.photopea.com/
// Someone using the same display: http://www.technoblogy.com/show?3YB0
// Another library for the display: https://github.com/zhcong/ST7302-for-arduino
// More info from u8g2 library: https://github.com/olikraus/u8g2/issues/2436
// More about sharp memory displays: https://www.youtube.com/watch?v=32pnqlTL5-Q
// Details about sharp memory displays: https://www.youtube.com/watch?v=VmronCahqd8
// Adafruit small memory display: https://www.adafruit.com/product/3502
// Adafruit big memory display: https://www.adafruit.com/product/4694
// Playdate game console (with memory display): https://s.click.aliexpress.com/e/_oE035yf

// Related videos with similar displays: 
// Car VFD Gauges with Arduino UNO: https://youtu.be/Frq_JP1lalE
// Posy’s designs ➔ REAL DISPLAYS: https://youtu.be/jz01j1TpM84
// Eink youtube counter: https://youtu.be/HFFhTrAkerU
// LCD display: https://youtu.be/8V2kQTOjFhE
// Display for watches: https://youtu.be/4M407AYPeH0
// More LCD displays: https://youtu.be/K5e0lFRvZ2E
// Segmented eink display: https://youtu.be/Rf-E-7fFop0


#include <Arduino.h> // including this is probably not needed, but it should not hurt
#include <U8g2lib.h> // u8g2 library is used to draw images on the display
#include <Wire.h> // library required for IIC communication

// LCD > Arduino UNO connection
//
// GND -> GND
// VCC -> 5V
// SCL (SPI clock) -> 13
// SDA (SPI data) -> 11
// RES (reset) -> 8
// DC (data/command) -> 9
// CS (chip select) -> 10

U8G2_ST7302_122X250_1_4W_HW_SPI u8g2(U8G2_R1, /* cs=*/ 10, /* dc=*/ 9, /* reset=*/ 8);

// fullscreen background image created in Photopea and generated from the image2cpp website
// 'reflective_LCD', 250x122px
const unsigned char epd_bitmap_reflective_LCD [] PROGMEM = {
	0x00, 0x00, 0x00, 0x00, 0x00, 0x00, 0x00, 0x00, 0x00, 0x00, 0x00, 0x00, 0x00, 0x00, 0x00, 0x00, 
	0x00, 0x00, 0x00, 0x00, 0x00, 0x00, 0x00, 0x00, 0x00, 0x00, 0x00, 0x00, 0x00, 0x00, 0x00, 0x00, 
	0x00, 0x00, 0x00, 0x00, 0x00, 0x00, 0x00, 0x00, 0x00, 0x00, 0x00, 0x00, 0x00, 0x00, 0x00, 0x00, 
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	0x00, 0x00, 0x00, 0x00, 0x00, 0x00, 0x00, 0x00, 0x00, 0x00, 0x00, 0x00, 0x00, 0x00, 0x00, 0x00
};




int fuel_value = 0; // fuel state 
int fuel_value_inc = 3; // fuel value increment

int temp_value = 80; // fuel state 
int temp_value_inc = -3; // temperature value increment


void setup(void) {
  u8g2.begin(); // start the u8g2 library
  u8g2.setContrast(255); // set the maximum brightness of the display
}

void loop(void) {

  // animate the fuel gauge in the ping-pong motion
  fuel_value = fuel_value + fuel_value_inc;
  if ((fuel_value >= 196) && (fuel_value_inc > 0)) {
    fuel_value_inc = -3;
  } else if ((fuel_value <= 0) && (fuel_value_inc < 0)) {
    fuel_value_inc = 3;
  }

  // animate the temperature gauge in the ping-pong motion
  temp_value = temp_value + temp_value_inc;
  if ((temp_value >= 196) && (temp_value_inc > 0)) {
    temp_value_inc = -3;
  } else if ((temp_value <= 0) && (temp_value_inc < 0)) {
    temp_value_inc = 3;
  }  


  u8g2.firstPage(); // needed for the u8g2 page mode
  do {

     u8g2.setDrawColor(1); // draw in white color
     u8g2.drawXBMP(0, 0, 250, 122, epd_bitmap_reflective_LCD); // draw fullscreen image generated by image2cpp website

     u8g2.setDrawColor(0); // draw in black color
    
     u8g2.drawBox(45 + fuel_value, 16, 196 - fuel_value, 20); // draw black filled box to cover the fuel gauge
     u8g2.drawBox(45 + temp_value, 78, 196 - temp_value, 20); // draw black filled box to cover the temperature gauge


  } while ( u8g2.nextPage() ); // this is required for the u8g2 page mode

}


